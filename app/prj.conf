## CMakeLists.txt
```
# set(BOARD nrf52_pca10040)

# Boilerplate code, which pulls in the Zephyr build system.
cmake_minimum_required(VERSION 3.13.1)
include($ENV{ZEPHYR_BASE}/cmake/app/boilerplate.cmake NO_POLICY_SCOPE)
project(app)

set(CMAKE_EXPORT_COMPILE_COMMANDS on)

# Add your source file to the "app" target. This must come after
# the boilerplate code, which defines the target.
target_sources(app PRIVATE src/main.c)
```

## prj.conf
```kconfig
CONFIG_GPIO=y
CONFIG_PRINTK=y
CONFIG_SENSOR=y
CONFIG_PWM=y
```

## src/main.c
```c
#include "setup.h"
#include "initial_settings.h"

// aux setas
int cont = 0;
s64_t tempoAnt = 0;
bool piscarDireita, piscarEsquerda = false;
// aux reed
int voltas = 0;
int estadoReed = 0;
s64_t tempoGasto = 0;
s64_t tempoInicial = 0;
int estadoAnteriorReed = 0;

void piscar_seta(output_t *out)
{
    s64_t tempo = k_uptime_get();
    if (piscarDireita || piscarEsquerda)
    {
        if (cont < 6)
        {
            if (tempo - tempoAnt >= 500)
            {
                tempoAnt = tempo;
                output_switch(&out);
                cont++;
            }
        }
        else
        {
            piscarDireita = false;
            piscarEsquerda = false;
            cont = 0;
        }
    }
}

void reedSwitch()
{
    input_read(&reed_switch, estadoReed);
    
    if (estadoReed > 0) 
    {
        if (estadoAnteriorReed != estadoReed)
        {
            estadoAnteriorReed = estadoReed;

            voltas++;
            float distTotal = voltas * (DIST_1VOLTA / 1000.0);

            s64_t t = k_uptime_get();
            s64_t tempoGastoM = (t - tempoInicial); // milisegundos
            tempoGasto = tempoGastoM / 1000.0;      // segundos
            tempoInicial = t;

            float velocInstantanea = 3.6 * (DIST_1VOLTA / tempoGasto); // 3,6*(m/s) = km/h

            // atualizar_display();
        }
    }
    else
    {
        estadoAnteriorReed = estadoReed;
    }
}

void main(void)
{

    printk("ECOM042.2019.2\n");
    printk("Embbebed System\n");
    printk("Smart Bike :)\n \n");

    leds_configure();
    buttons_configure();
    sensors_configure();
    display_configure();

    while (1)
    {
        // colocar seta pra direita e seta pra esquerda numa funcao
        // o codigo sera o mesmo
        switch (botao_pressionado)
        {
        case 0: // seta pra direita
            printk("seta pra direita\n");
            piscarDireita = true;
            piscarEsquerda = false;
            output_set(&led_seta_esquerda, OFF);
            break;

        case 1: // seta pra esqueda
            printk("seta pra esquerda\n");
            piscarEsquerda = true;
            piscarDireita = false;
            output_set(&led_seta_direita, OFF);
            break;

        case 2: // freio
            printk("freio\n");
            output_switch(&led_freio);
            break;

        default:
            break;
        }
        botao_pressionado = -1;

        if (piscarDireita)
            piscar_seta(&led_seta_direita);
        if (piscarEsquerda)
            piscar_seta(&led_seta_esquerda);
        // atualizar_farois();
        // atualizar_display();
    }
}
```

## include/farol.h
```c
#ifndef _FAROL_H_
#define _FAROL_H_

#include "ldr.h"
#include <pwm.h>
#include <device.h>

struct device *pwm_dev;
int pwm_pulse = 0;
int sensibilidade = 50; // ajustar esse valor depois

int pulse_min = 15;
int pulse_max = 100;

// função que inicializa o led pwm
void configure_pwm();

// função que muda o valor do led pwm
void pwm_set();

#endif
```

## include/initial_settings.h
```c
#ifndef _INITIAL_SETTINGS_H_
#define _INITIAL_SETTINGS_H_

#include "output.h"
#include "input.h"

// Structs do tipo input representando cada botão, ldr e reed switch
input_t botao_seta_direita, botao_seta_esquerda, botao_freio, ldr_dianteiro, ldr_traseiro, reed_switch;

// Structs do tipo output representando cada led
output_t led_seta_direita, led_seta_esquerda, led_freio, led_farol_traseiro, led_farol_dianteiro;

void leds_configure();
void buttons_configure();
void sensors_configure();
void display_configure();

#endif
```

## include/input.h
```c
#ifndef _INPUT_H_
#define _INPUT_H_

#include <device.h>
#include <gpio.h>

struct input {
    struct device *device;
    struct gpio_callback gpio_callback;
    char *dev_label;
    u32_t pin;
};

int botao_pressionado = -1;

typedef struct input input_t;

// construtor do botão
void input_constructor(input_t *input, u32_t pin, char *label);

// Essa função tem como objetivo iniciar o device do driver de entrada.
int input_open(input_t *in, char *dev_label);

// Essa função tem como objetivo configurar o pino de entrada.
int input_configure(input_t *in, u32_t pin, int flags, gpio_callback_handler_t cb);

// Essa função tem como objetivo fazer uma leitura do pino
int input_read(input_t *in, u32_t *state);

// Função para identificar qual botão foi pressionado
void button_pressed(struct device *btn, struct gpio_callback *cb, u32_t pins);

#endif
```

## include/ldr.h
```c
#ifndef _LDR_H_
#define _LDR_H_

#include <device.h>

struct device *dev;
struct sensor_value lum;

// ajustar essa range
int ldr_min = 0;
int ldr_max = 1023;

// função que inicializa o LDR
void configure_ldr();

// função que recupera os dados do LDR
int get_ldr_data();

#endif
```

## include/output.h
```c
#ifndef _OUTPUT_H_
#define _OUTPUT_H_

#include <device.h>
#include <gpio.h>

struct output {
    struct device *device;
    char *dev_label;
    u32_t pin;
    u8_t state;
};

typedef struct output output_t;

// construtor do dispositivo de saída
void output_constructor(output_t *out, u32_t pin, char *label, u8_t state);

// Essa função tem como objetivo iniciar o dispositivo de saída
int output_open(output_t *out, char *dev_label);

// Essa função tem como objetivo configurar o pino de saída
int output_configure(output_t *out, u32_t pin, int flags);

// Essa função tem como objetivo configurar a mudança de estado de um dispositivo de saída
int output_set(output_t *out, u8_t value);

// ?
int output_pressed(output_t *out);

// Essa função tem como objetivo dar um "toggle" no estado do dispositivo
void output_switch(output_t *out);

#endif
```

## include/setup.h
```c
// Flags de interrupções do GPIO
#define INTERRUPT GPIO_INT
#define FALLING_EDGE (GPIO_INT_EDGE | GPIO_INT_ACTIVE_LOW)
#define DEBOUNCE GPIO_INT_DEBOUNCE
#define PULL_UP GPIO_PUD_PULL_UP
#define SW_GPIO_FLAGS (INTERRUPT | FALLING_EDGE | DEBOUNCE | PULL_UP)

// saída
// 1 = seta direita (led)
// 2 = seta esquerda (led)
// 3 = freio (led)
#define led_one_PORT LED1_GPIO_CONTROLLER
#define led_two_PORT LED2_GPIO_CONTROLLER
#define led_three_PORT LED3_GPIO_CONTROLLER

#define led_one_PIN LED1_GPIO_PIN
#define led_two_PIN LED2_GPIO_PIN
#define led_three_PIN LED3_GPIO_PIN

// entrada
// 0 = seta direita (botao)
// 1 = seta esqueda (botao)
// 2 = freio (botao)
// 3 = reed switch (botao)
// 4 = ldr 
#define SW0_PORT SW0_GPIO_CONTROLLER
#define SW1_PORT SW1_GPIO_CONTROLLER
#define SW2_PORT SW2_GPIO_CONTROLLER
#define SW3_PORT SW3_GPIO_CONTROLLER
#define SW4_PORT SW4_GPIO_CONTROLLER
#define SW5_PORT SW5_GPIO_CONTROLLER

#define SW0_PIN SW0_GPIO_PIN
#define SW1_PIN SW1_GPIO_PIN
#define SW2_PIN SW2_GPIO_PIN
#define SW3_PIN SW3_GPIO_PIN
#define SW4_PIN SW4_GPIO_PIN
#define SW5_PIN SW5_GPIO_PIN

// PWM
#define PWM_DRIVER	CONFIG_PWM_NRF5_SW_0_DEV_NAME
#define PWM_CHANNEL	LED0_GPIO_PIN
#define PWM_FLAGS	0

// outros defines
// pros leds
#define ON 1
#define OFF 0
// pro reed switch
// distancia percorrida em 1 volta do pneu
// considerando aro 26, cujo diâmetro é de 559mm = 0,559m
#define DIST_1VOLTA = PI * 0.559; // metros
// pro pwm
#define PERIOD (USEC_PER_SEC / 50)
// geral
#define SLEEP_TIME 500 //ms
```

## include/state_machine.h
```c
#ifndef _STATE_MACHINE_H_
#define _STATE_MACHINE_H_

#include "thread.h"
#include <device.h>
#include <gpio.h>

void state_machine();

void set_pedalando();

void set_freiando();

void set_alerta();

void set_reset();

int get_state();

#endif
```

## include/thread.h
```c
#ifndef _THREAD_H_
#define _THREAD_H_

#include <device.h>
#include <gpio.h>
#include "state_machine.h"

extern const k_tid_t farol_id;
extern const k_tid_t sensor_id;

void farol_thread();

void sensor_thread();


#endif
```

## src/analogInput.c
```c
#include "include/analogInput.h"

#include <device.h>
#include <sys/printk.h>

void analog_input_open (device *dev, char *dev_label) {
    *dev = device_get_binding(dev_label);

    if(dev->device == NULL){
        printk("open_sensor: ERRO na atribução do device\n");
        return -1;
    } else {
        printk("open_sensor: sem erros\n");
        return 0;
    }
}

int analog_input_read (device *dev, struct sensor_value value) {
    if (sensor_sample_fetch(dev)) {
        printk("sensor_sample fetch failed\n");
        return -1;
	}
    
    sensor_channel_get(dev, SENSOR_CHAN_LIGHT, &value);
    printk("ambient light intensity %d", value.val1);

    return value.val1;
}
```

## src/farol.c
```c
#include "setup.h"
#include "farol.h"

void configure_pwm() {
    configure_ldr();

    pwm_dev = device_get_binding(PWM_DRIVER);

    if (!pwm_dev) {
		printk("configure_pwm: erro na inicialização %s!\n", PWM_DRIVER);
		return;
	}
}

void pwm_set() {
    int lum = get_ldr_data();
    double var = 1.0 * (pulse_max - pulse_min) / (ldr_max - sensibilidade);
    pwm_pulse = pulse_min + var * (lum - sensibilidade);

    pwm_pin_set_usec(pwm_dev, PWM_CHANNEL, PERIOD, pwm_pulse);
}
```

## src/initial_settings.c
```c
#include "setup.h"
#include "initial_settings.h"

void leds_configure() {
    output_constructor(&led_seta_direita, led_zero_PIN, led_zero_PORT, OFF);
    output_constructor(&led_seta_esquerda, led_one_PIN, led_one_PORT, OFF);
    output_constructor(&led_freio, led_two_PIN, led_two_PORT, OFF);
    output_constructor(&led_farol_traseiro, led_three_PIN, led_three_PORT, OFF);
    output_constructor(&led_farol_dianteiro, led_four_PIN, led_four_PORT, OFF);
}

void buttons_configure () {
    input_constructor(&botao_seta_direita, SW0_PIN, SW0_PORT);
    input_constructor(&botao_seta_esquerda, SW1_PIN, SW1_PORT);
    input_constructor(&botao_freio, SW2_PIN, SW2_PORT);
}

void sensors_configure() {
    input_constructor(&ldr_dianteiro, SW3_PIN, SW3_PORT);
    input_constructor(&ldr_traseiro, SW4_PIN, SW4_PORT);
    input_constructor(&reed_switch, SW5_PIN, SW5_PORT);
}

void display_configure() {
    // implementar
}
```

## src/input.c
```c
#include "setup.h"
#include "input.h"

/*
 * funções retornarão:
 *  -> 0 se não houver erro
 *  -> valor negativo se houver
 */

// construtor 
void input_constructor(input_t *input, u32_t pin, char *label){
    int e = input_open(input, label);
    if(e = NULL){
        printk("Alerta: Botao para o PIN%d não inicializado.\n", pin);
        return;
    }
    input_configure(input, pin, GPIO_DIR_IN | SW_GPIO_FLAGS, button_pressed);
    printk("Botao em PIN%d inicializado.\n", pin);
}

void 

// Inicialização do dispositivo de entrada
int input_open(input_t *in, char *dev_label) {
    in->dev_label = dev_label;
    in->device = device_get_binding(in->dev_label);

    if(in->device == NULL){
        printk("input_open: ERRO na atribução do in->device\n");
        return -1;
    } else {
        printk("input_open: sem erros\n");
        return 0;
    }
}
// Configuração do dispositivo de entrada
int input_configure(input_t *in, u32_t pin, int flags, gpio_callback_handler_t cb) {
    int ret = gpio_pin_configure(in->device, in->pin, flags);
    ret += gpio_init_callback(&in->gpio_callback, cb, BIT(in->pin));
    ret += gpio_add_callback(in->device, &in->gpio_callback);
    ret += gpio_pin_enable_callback(in->device, in->pin);
    
    if (ret == 0) {
        printk("input_configure: sem erros\n");
        return 0;
    } else {
        printk("input_configure: ERRO\n");
        return -1;
    } 
}

// Fazendo leitura do sinal em um dispositivo de entrada
int input_read(input_t *in, u32_t *value) {
    int ret = gpio_pin_read(in->device, in->pin, value);
    
    if (ret == 0) {
        printk("input_read: sem erros\n");
        return 0;
    } else {
        printk("input_read: ERRO %d\n", ret);
        return -1;
    }
}

// Função para identificar qual botão foi pressionado
void button_pressed(struct device *btn, struct gpio_callback *cb, u32_t pins){
    if(pins & BIT(SW0_PIN)) {
        botao_pressionado = 0; 
        printk("Botao 0 (seta direita) pressionado em %d ciclos\n", k_cycle_get_32());
    } else if(pins & BIT(SW1_PIN)) {
        botao_pressionado = 1
        printk("Botao 1 (seta esquerda) pressionado em %d ciclos\n", k_cycle_get_32());
    } else  {
        botao_pressionado = 2;
        printk("Botao 2 (freio) pressionado em %d ciclos\n", k_cycle_get_32());
    }
}
```
